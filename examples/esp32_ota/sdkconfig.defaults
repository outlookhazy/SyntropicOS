## examples/esp32_ota/sdkconfig.defaults
```kconfig
# SyntropicOS ESP32 OTA Example — SDK defaults
# Target: Olimex ESP32-PoE (ESP32-WROOM)

# Flash size
CONFIG_ESPTOOLPY_FLASHSIZE_4MB=y

# Console UART
CONFIG_ESP_CONSOLE_UART_DEFAULT=y
CONFIG_ESP_CONSOLE_UART_BAUDRATE=115200

# WiFi
CONFIG_ESP_WIFI_SSID=""
CONFIG_ESP_WIFI_PASSWORD=""

# Partition table — custom with syn_param storage
CONFIG_PARTITION_TABLE_CUSTOM=y
CONFIG_PARTITION_TABLE_CUSTOM_FILENAME="partitions.csv"

# Disable Bluetooth (saves flash/RAM)
CONFIG_BT_ENABLED=n

# Enable NEWLIB for getchar() non-blocking
CONFIG_VFS_SUPPORT_IO=y
```
