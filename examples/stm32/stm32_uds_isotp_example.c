/**
 * @file stm32_uds_isotp_example.c
 * @brief SyntropicOS STM32 UDS (ISO 14229) over ISO-TP (ISO 15765-2) CAN Example.
 *
 * Demonstrates integrating UDS diagnostic server on STM32 using ISO-TP transport over CAN.
 * Supports DiagnosticSessionControl, SecurityAccess, ReadDataByIdentifier (RDBI),
 * WriteDataByIdentifier (WDBI), AccessTimingParameter (0x83), RoutineControl, and ECUReset.
 */

#include "syntropic/syntropic.h"
#include "syntropic/drivers/syn_can.h"
#include "syntropic/log/syn_log.h"
#include "syntropic/proto/syn_isotp.h"
#include "syntropic/proto/syn_uds.h"
#include "syntropic/sched/syn_sched.h"

#include <stdbool.h>
#include <stdint.h>
#include <string.h>

#define STM32_UDS_RX_CAN_ID 0x7E0U
#define STM32_UDS_TX_CAN_ID 0x7E8U

/* UDS Server & CAN Bus Instances */
static SYN_UDS_Server g_uds;
static SYN_CAN g_can;

/* ISO-TP Transport Instance Context & Buffers */
static SYN_ISOTP_Link g_isotp;
static uint8_t g_rx_buf[256];
static uint8_t g_tx_buf[256];

/* Scheduler & Task Handles */
static SYN_Task g_uds_task;
static SYN_Sched g_sched;

/* Shared DID Memory Buffers */
static uint8_t g_vin_did[18] = "SYN1234567890ABCD";
static uint8_t g_battery_volts[2] = {0x00, 0x78}; /* 12.0 Volts */

/* Simulated CAN hardware receive hook */
static void on_can_frame_received(uint32_t can_id, const uint8_t data[8], uint8_t len)
{
    if (can_id == STM32_UDS_RX_CAN_ID) {
        SYN_CAN_Frame frame = {0};
        frame.id = can_id;
        frame.dlc = (len > 8) ? 8 : len;
        memcpy(frame.data, data, frame.dlc);
        syn_isotp_process_rx_frame(&g_isotp, &frame);
    }
}

/* Hardware reset callback invoked by UDS 50ms after positive response 0x51 is sent */
static void on_ecu_reset(uint8_t reset_type, void *ctx)
{
    (void)ctx;
    switch (reset_type) {
    case SYN_UDS_RESET_HARD:
    case SYN_UDS_RESET_KEY_OFF_ON:
    case SYN_UDS_RESET_SOFT:
    case SYN_UDS_RESET_ENABLE_RAPID_POWER_SHUTDOWN:
    case SYN_UDS_RESET_DISABLE_RAPID_POWER_SHUTDOWN:
    default:
        /* Execute hardware system reset (e.g. NVIC_SystemReset() on ARM Cortex-M) */
        break;
    }
}

/* Periodic 10ms task servicing ISO-TP transport & UDS request processing */
static SYN_PT_Status app_10ms_task(SYN_PT *pt, SYN_Task *task)
{
    PT_BEGIN(pt);

    for (;;) {
        /* Step ISO-TP and UDS timers */
        syn_isotp_step(&g_isotp, 10);
        syn_uds_tick(&g_uds, 10);

        /* Drain pending outgoing CAN frames generated by ISO-TP engine */
        SYN_CAN_Frame tx_frame;
        while (syn_isotp_get_tx_frame(&g_isotp, &tx_frame)) {
            syn_can_send(&g_can, &tx_frame);
        }

        /* Check if full UDS request payload received over ISO-TP */
        uint8_t req_buf[256];
        ssize_t req_len = syn_isotp_receive(&g_isotp, req_buf, sizeof(req_buf));
        if (req_len > 0) {
            uint8_t resp_buf[256];
            uint16_t resp_len = 0;

            /* Process UDS diagnostic request */
            if (syn_uds_process_request(&g_uds, req_buf, (uint16_t)req_len, resp_buf,
                                        sizeof(resp_buf), &resp_len, SYN_UDS_ADDR_PHYSICAL)) {
                /* Transmit UDS response over ISO-TP multi-frame transport */
                syn_isotp_send(&g_isotp, resp_buf, resp_len);
            }
        }

        PT_TASK_DELAY_MS(pt, task, 10);
    }

    PT_END(pt);
}

/* Custom Callback Handler for Service 0x83 AccessTimingParameter */
static bool on_access_timing(SYN_UDS_AccessTimingType timing_type, uint16_t *p2_max_ms,
                             uint16_t *p2_star_max_10ms, void *ctx)
{
    (void)ctx;
    switch (timing_type) {
    case SYN_UDS_TIMING_READ_EXTENDED:
    case SYN_UDS_TIMING_READ_ACTIVE:
        /* Report configured timing limits: P2Server_max = 50 ms, P2*Server_max = 500 ms (5000 ms) */
        if (p2_max_ms != NULL) {
            *p2_max_ms = 50U;
        }
        if (p2_star_max_10ms != NULL) {
            *p2_star_max_10ms = 500U;
        }
        return true;
    case SYN_UDS_TIMING_SET_TO_DEFAULT:
        if (p2_max_ms != NULL) {
            *p2_max_ms = 50U;
        }
        if (p2_star_max_10ms != NULL) {
            *p2_star_max_10ms = 500U;
        }
        return true;
    case SYN_UDS_TIMING_SET_TO_GIVEN:
        /* Validate requested timing parameters before applying */
        if (p2_max_ms != NULL && *p2_max_ms < 10U) {
            return false; /* Reject invalid / unsafe P2Server_max */
        }
        return true;
    default:
        return false;
    }
}

/* Custom DTC Callback Handler for Service 0x19 Snapshot/Extended Data */
static bool on_custom_dtc_handler(uint8_t subfunction, const uint8_t *in_data, uint16_t in_len,
                                  uint8_t *out_buf, uint16_t max_out_len, uint16_t *out_len,
                                  void *ctx)
{
    (void)ctx;
    if (subfunction == SYN_UDS_DTC_REPORT_SNAPSHOT_RECORD_BY_DTC && in_len >= 4 && max_out_len >= 6) {
        out_buf[0] = in_data[0]; /* DTC High */
        out_buf[1] = in_data[1]; /* DTC Mid */
        out_buf[2] = in_data[2]; /* DTC Low */
        out_buf[3] = 0x24U;      /* Status */
        out_buf[4] = in_data[3]; /* Record Number */
        out_buf[5] = 0x01U;      /* Number of DIDs */
        *out_len = 6U;
        return true;
    }
    return false;
}

void stm32_uds_isotp_example_init(void)
{
    (void)on_can_frame_received;

    syn_can_init(&g_can, 0U, 500000U);

    /* Initialize UDS Server */
    syn_uds_init(&g_uds);

    /* Register AccessTimingParameter (0x83) callback handler */
    syn_uds_register_access_timing(&g_uds, on_access_timing, NULL);

    /* Register custom DTC callback handler */
    syn_uds_register_dtc_handler(&g_uds, on_custom_dtc_handler, NULL);

    /* Register deferred post-TX ECU reset handler (50ms post-TX wait window) */
    syn_uds_set_reset_handler(&g_uds, on_ecu_reset, NULL);
    syn_uds_set_reset_wait_ms(&g_uds, 50);

    /* Register Data Identifiers (DIDs) */
    syn_uds_register_did(&g_uds, 0xF190U, g_vin_did, sizeof(g_vin_did), false); /* VIN (RO) */
    syn_uds_register_did(&g_uds, 0x0100U, g_battery_volts, sizeof(g_battery_volts),
                         true); /* Batt Volts (RW) */

    /* Register Generic DTCs for 0x14 (ClearDTC) & 0x19 (ReadDTCInformation) */
    syn_uds_register_dtc(&g_uds, 0x911717U, 0x09U, 0x00U); /* B111717: Battery voltage too high */
    syn_uds_register_dtc(&g_uds, 0x911716U, 0x09U, 0x00U); /* B111716: Battery voltage too low */
    syn_uds_register_dtc(&g_uds, 0xC13100U, 0x09U, 0x00U); /* U013100: Lost comm with EPS */
    syn_uds_register_dtc(&g_uds, 0xC10100U, 0x09U, 0x00U); /* U010100: Lost comm with TCU */
    syn_uds_register_dtc(&g_uds, 0xC12100U, 0x09U, 0x00U); /* U012100: Lost comm with ABS/ESP */
    syn_uds_register_dtc(&g_uds, 0xC12600U, 0x09U, 0x00U); /* U012600: Lost comm with SAS */
    syn_uds_register_dtc(&g_uds, 0xC12300U, 0x09U, 0x00U); /* U012300: Lost comm with YRS */

    /* Initialize ISO-TP Link */
    syn_isotp_init(&g_isotp, STM32_UDS_RX_CAN_ID, STM32_UDS_TX_CAN_ID, g_rx_buf, sizeof(g_rx_buf),
                   g_tx_buf, sizeof(g_tx_buf));

    /* Initialize task and scheduler */
    syn_task_create(&g_uds_task, "uds_isotp_task", app_10ms_task, SYN_PRIO_HIGH, NULL);
    syn_sched_init(&g_sched, &g_uds_task, 1);
}
